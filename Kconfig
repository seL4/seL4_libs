## Kconfig
```kconfig
#
# Copyright 2014, NICTA
#
# This software may be distributed and modified according to the terms of
# the BSD 2-Clause license. Note that NO WARRANTY is provided.
# See "LICENSE_BSD2.txt" for details.
#
# @TAG(NICTA_BSD)
#

config LIB_SEL4_SIMPLE
    bool "libsel4simple"
    depends on HAVE_LIB_SEL4 && HAVE_LIBC && HAVE_LIB_SEL4_VKA
    select HAVE_SEL4_LIBS
    select HAVE_LIB_SEL4_SIMPLE
    default y
    help
        Simple resource abstraction interface for seL4 based applications

config HAVE_LIB_SEL4_SIMPLE
    bool
```

## libsel4allocman/Kconfig
```kconfig
#
# Copyright 2017, Data61
# Commonwealth Scientific and Industrial Research Organisation (CSIRO)
# ABN 41 687 119 230.
#
# This software may be distributed and modified according to the terms of
# the BSD 2-Clause license. Note that NO WARRANTY is provided.
# See "LICENSE_BSD2.txt" for details.
#
# @TAG(DATA61_BSD)
#

menuconfig LIB_SEL4_ALLOCMAN
    bool "libsel4allocman"
    default y
    depends on HAVE_LIB_SEL4 && HAVE_LIBC && HAVE_LIB_SEL4_VKA && HAVE_LIB_SEL4_UTILS && \
               HAVE_LIB_SEL4_VSPACE && HAVE_LIB_SEL4_SIMPLE && HAVE_LIB_UTILS && HAVE_LIB_SEL4_PLAT_SUPPORT
    select HAVE_LIB_SEL4_ALLOCMAN
    help
        Allocation manager library for seL4

config HAVE_LIB_SEL4_ALLOCMAN
    bool
```

## libsel4bench/Kconfig
```kconfig
#
# Copyright 2017, Data61
# Commonwealth Scientific and Industrial Research Organisation (CSIRO)
# ABN 41 687 119 230.
#
# This software may be distributed and modified according to the terms of
# the BSD 2-Clause license. Note that NO WARRANTY is provided.
# See "LICENSE_BSD2.txt" for details.
#
# @TAG(DATA61_BSD)
#

menuconfig LIB_SEL4_BENCH
    bool "libsel4bench"
    default y
    depends on HAVE_LIB_SEL4 && HAVE_LIBC && HAVE_LIB_UTILS
    select HAVE_LIB_SEL4_BENCH
    help
        Benchmarking library and functionality for various platforms

config FLOG
    bool "Enable fast logging library?"
    default n
    depends on LIB_SEL4_BENCH
    help
        Provide flog.h functions. If this is false, flog.h functions will be #ifdef'd out.

config HAVE_LIB_SEL4_BENCH
    bool
```

## libsel4cachecolour/Kconfig
```kconfig
# @LICENSE(NICTA_CORE)

menuconfig LIB_SEL4_CACHECOLOURING
    bool "cache colouring allocator"
    default y
    depends on LIB_SEL4 && HAVE_LIBC && LIB_SEL4_VKA && LIB_SEL4_ALLOCMAN
    help
        cache coloring allocator for partitioning the physically-indexed cache
    
    config NUM_CACHE_COLOURS 
    int "Number of cache colours on this platform" 
    depends on LIB_SEL4_CACHECOLOURING 
    default  32 
    help 
          number of page colours that the user would like to colouring the cache 

     config COLOUR_ALLOC_SIZEBITS
     int "allocated untype for all colours (Bits)" 
     depends on LIB_SEL4_CACHECOLOURING 
     default 17  
     help 
           the maximum untype size that is managed by cache colouring allocator. It then breaks the untype into few coloured unyptes (pages).

     config COLOUR_MSPACE_RESERVES
     int "number of chunks reserved for the utype nodes in mspace"
     depends on LIB_SEL4_CACHECOLOURING 
     default 10
     help  
            in mspace refill the water mark with the static memory pool, handling the recursive allocation for the untype retypes, cache colouring allocator may be called recurisively for inserting coloured untype nodes. 
```

## libsel4debug/Kconfig
```kconfig
#
# Copyright 2017, Data61
# Commonwealth Scientific and Industrial Research Organisation (CSIRO)
# ABN 41 687 119 230.
#
# This software may be distributed and modified according to the terms of
# the BSD 2-Clause license. Note that NO WARRANTY is provided.
# See "LICENSE_BSD2.txt" for details.
#
# @TAG(DATA61_BSD)
#

menuconfig LIB_SEL4_DEBUG
    bool "libsel4debug"
    depends on HAVE_LIB_SEL4 && HAVE_LIBC && HAVE_LIB_SEL4_UTILS
    select HAVE_LIB_SEL4_DEBUG
    default y
    help
        A user level debugging library for seL4

    config LIBSEL4DEBUG_ALLOC_BUFFER_ENTRIES
    int "Pointer tracking buffer entries"
    depends on LIB_SEL4_DEBUG
    default 128
    help
        Size of buffer to use for tracking memory allocations within
        instrumentation. This setting has no effect if you are not using the
        allocation instrumentation. Setting this value to 0 disables pointer
        tracking.

    choice
    prompt "Function instrumentation"
    default LIBSEL4DEBUG_FUNCTION_INSTRUMENTATION_NONE
    depends on LIB_SEL4_DEBUG
    help
        Instrumentation to apply to function calls. This setting will only have
        an effect when your CFLAGS include -finstrument-functions, in which
        case __cyg_profile_func_enter will be called on every function entry
        and __cyg_profile_func_exit will be called on every function exit. The
        value of this setting determines the implementation of
        __cyg_profile_func_enter and __cyg_profile_func_exit supplied by this
        library. Regardless of the option you select, you can always override
        the implementation by providing your own in your application.

    config LIBSEL4DEBUG_FUNCTION_INSTRUMENTATION_NONE
    bool "none"
    help
        No implementation of __cyg_profile_func_enter and
        __cyg_profile_func_exit are provided.

    config LIBSEL4DEBUG_FUNCTION_INSTRUMENTATION_TRACE
    bool "printf trace"
    help
        Print entry and exit of every function call. This option is useful for
        a very coarse and noisy description of what your code is doing.

    config LIBSEL4DEBUG_FUNCTION_INSTRUMENTATION_BACKTRACE
    bool "backtrace"
    help
        Track function calls for the purposes of a backtrace. You will need to
        enable this option if you want to retrieve programmatic backtraces.

    endchoice

config HAVE_LIB_SEL4_DEBUG
    bool
```

## libsel4muslcsys/Kconfig
```kconfig
#
# Copyright 2017, Data61
# Commonwealth Scientific and Industrial Research Organisation (CSIRO)
# ABN 41 687 119 230.
#
# This software may be distributed and modified according to the terms of
# the BSD 2-Clause license. Note that NO WARRANTY is provided.
# See "LICENSE_BSD2.txt" for details.
#
# @TAG(DATA61_BSD)
#

menuconfig LIB_SEL4_MUSLC_SYS
    bool "libsel4muslcsys"
    default y
    depends on HAVE_LIB_SEL4 && HAVE_LIBC && HAVE_LIB_SEL4_UTILS && \
               HAVE_LIB_SEL4_VSPACE && HAVE_LIB_CPIO
    select HAVE_LIB_SEL4_MUSLC_SYS
    help
        Minimal muslc syscall implementation for seL4.

config LIB_SEL4_MUSLC_SYS_MORECORE_BYTES
    int "Malloc limit"
    default 1048576
    depends on LIB_SEL4_MUSLC_SYS
    help
        This value sets the number of bytes reserved for the region malloc
        allocates from. Note that you won't actually be able to allocate this
        entire amount because there is some bookkeeping overhead. This area is
        allocated statically.

config LIB_SEL4_MUSLC_SYS_DEBUG_HALT
    bool "Perform seL4_DebugHalt on _exit and _abort"
    default true
    depends on LIB_SEL4_MUSLC_SYS
    help
        Controls whether or not a DebugHalt should be called to implement Exit
        style syscalls. This is useful if you have a single app and thread, but
        should be turned off if using multiple threads that may wish to exit
        independently of the whole system

config LIB_SEL4_MUSLC_SYS_CPIO_FS
    bool "Implementation of a simple file system using CPIO archives"
    default false
    depends on LIB_SEL4_MUSLC_SYS
    help
        If this is enabled open and read syscalls will attempt to use the cpio archive
        _cpio_archive. This implements a basic read only POSIX interface to that file system

config LIB_SEL4_MUSLC_SYS_ARCH_PUTCHAR_WEAK
    bool "Make __arch_putchar a weak symbol"
    default n
    depends on LIB_SEL4_MUSLC_SYS
    help
        This allows you to override __arch_putchar in another library or your
	application.

config HAVE_LIB_SEL4_MUSLC_SYS
    bool
```

## libsel4platsupport/Kconfig
```kconfig
#
# Copyright 2017, Data61
# Commonwealth Scientific and Industrial Research Organisation (CSIRO)
# ABN 41 687 119 230.
#
# This software may be distributed and modified according to the terms of
# the BSD 2-Clause license. Note that NO WARRANTY is provided.
# See "LICENSE_BSD2.txt" for details.
#
# @TAG(DATA61_BSD)
#

menuconfig LIB_SEL4_PLAT_SUPPORT
    bool libsel4platsupport
    depends on HAVE_LIB_SEL4 && HAVE_LIBC && HAVE_LIB_SEL4_VSPACE && \
               HAVE_LIB_SEL4_SIMPLE && HAVE_LIB_PLATSUPPORT && HAVE_LIB_UTILS && HAVE_LIB_SEL4_VKA
    select HAVE_LIB_SEL4_PLAT_SUPPORT
    default y
    help
        seL4 dependent driver and platform library

config LIB_SEL4_PLAT_SUPPORT_USE_SEL4_DEBUG_PUTCHAR
    bool "Redirect putchar() to seL4_DebugPutchar()"
    depends on LIB_SEL4_PLAT_SUPPORT && PRINTING
    default y
    help
        Direct putchar() to seL4_DebugPutchar() instead of writing directly to the COM port.

config LIB_SEL4_PLAT_SUPPORT_START
    bool "Supply _start entry point"
    depends on LIB_SEL4_PLAT_SUPPORT
    default y if !HAVE_CRT
    help
        Emit _start with a default definition that sets up a stack and does
        what's required to enter main().

config LIB_SEL4_PLAT_SUPPORT_SEL4_START
    bool "Supply _sel4_start entry point"
    depends on LIB_SEL4_PLAT_SUPPORT
    default y if HAVE_CRT
    help
        Emit a _sel4_start that sets up a stack and does
        what's required to enter a regular _start routine

config HAVE_LIB_SEL4_PLAT_SUPPORT
    bool
```

## libsel4serialserver/Kconfig
```kconfig
#
# Copyright 2017, Data61
# Commonwealth Scientific and Industrial Research Organisation (CSIRO)
# ABN 41 687 119 230.
#
# This software may be distributed and modified according to the terms of
# the BSD 2-Clause license. Note that NO WARRANTY is provided.
# See "LICENSE_BSD2.txt" for details.
#
# @TAG(DATA61_BSD)
#

menuconfig LIB_SEL4_SERIAL_SERVER
    bool "libsel4serialserver"
    depends on HAVE_LIB_SEL4 && HAVE_LIBC && HAVE_LIB_ELF && HAVE_LIB_UTILS && HAVE_LIB_SEL4_UTILS && HAVE_LIB_SEL4_TEST
    default y
    help
        Serial server.

config SERIAL_SERVER_COLOURED_OUTPUT
    depends on LIB_SEL4_SERIAL_SERVER
    bool "Annotate output with differnet ansi colours for each client"
    default y

config HAVE_LIB_SEL4_SERIAL_SERVER
    default y
    bool
```

## libsel4simple-default/Kconfig
```kconfig
#
# Copyright 2017, Data61
# Commonwealth Scientific and Industrial Research Organisation (CSIRO)
# ABN 41 687 119 230.
#
# This software may be distributed and modified according to the terms of
# the BSD 2-Clause license. Note that NO WARRANTY is provided.
# See "LICENSE_BSD2.txt" for details.
#
# @TAG(DATA61_BSD)
#

config LIB_SEL4_SIMPLE_DEFAULT
    bool "libsel4simple-default"
    depends on HAVE_LIB_SEL4 && HAVE_LIBC && HAVE_LIB_SEL4_SIMPLE && HAVE_LIB_SEL4_VSPACE && HAVE_LIB_UTILS
    select HAVE_SEL4_LIBS
    select HAVE_LIB_SEL4_SIMPLE_DEFAULT
    default y
    help
        Implementation of libsel4simple abstraction for the master branch of seL4

config HAVE_LIB_SEL4_SIMPLE_DEFAULT
    bool
```

## libsel4simple-stable/Kconfig
```kconfig
#
# Copyright 2014, NICTA
#
# This software may be distributed and modified according to the terms of
# the BSD 2-Clause license. Note that NO WARRANTY is provided.
# See "LICENSE_BSD2.txt" for details.
#
# @TAG(NICTA_BSD)
#

config LIB_SEL4_SIMPLE_STABLE
    bool "libsel4simple-stable"
    depends on HAVE_LIB_SEL4 && HAVE_LIBC && HAVE_LIB_SEL4_SIMPLE && HAVE_LIB_SEL4_UTILS && HAVE_LIB_SEL4_VKA
    select HAVE_SEL4_LIBS
    select HAVE_LIB_SEL4_SIMPLE_STABLE
    default y
    help
        Implementation of libsel4simple abstraction for the experimental branch (searchable CDT) of the kernel

config HAVE_LIB_SEL4_SIMPLE_STABLE
    bool
```

## libsel4sync/Kconfig
```kconfig
#
# Copyright 2017, Data61
# Commonwealth Scientific and Industrial Research Organisation (CSIRO)
# ABN 41 687 119 230.
#
# This software may be distributed and modified according to the terms of
# the BSD 2-Clause license. Note that NO WARRANTY is provided.
# See "LICENSE_BSD2.txt" for details.
#
# @TAG(DATA61_BSD)
#

config LIB_SEL4_SYNC
    bool "libsel4sync"
    depends on HAVE_LIB_SEL4 && HAVE_LIBC && HAVE_LIB_SEL4_VKA && HAVE_LIB_UTILS && HAVE_LIB_PLATSUPPORT
    select HAVE_SEL4_LIBS
    select HAVE_LIB_SEL4_SYNC
    default y
    help
        Synchronisation library for seL4

config HAVE_LIB_SEL4_SYNC
    bool
```

## libsel4test/Kconfig
```kconfig
#
# Copyright 2017, Data61
# Commonwealth Scientific and Industrial Research Organisation (CSIRO)
# ABN 41 687 119 230.
#
# This software may be distributed and modified according to the terms of
# the BSD 2-Clause license. Note that NO WARRANTY is provided.
# See "LICENSE_BSD2.txt" for details.
#
# @TAG(DATA61_BSD)
#

menuconfig LIB_SEL4_TEST
    bool "libsel4test"
    depends on HAVE_LIBC && HAVE_LIB_UTILS
    select HAVE_LIB_SEL4_TEST
    default y
    help
        A test framework and output formatting library

config TESTPRINTER_REGEX
    string "Tests to perform"
    default ".*"
    depends on LIB_SEL4_TEST
    help
        A POSIX regex pattern that is used to filter the tests to run

config TESTPRINTER_HALT_ON_TEST_FAILURE
    bool "Halt on the first test failure"
    default n
    depends on LIB_SEL4_TEST
    help
        Default behaviour is to try and run the test suite, regardless of any failures.
        Turning this on will stop the test suite on the first error

config PRINT_XML
    bool "Print XML output"
    default n
    depends on LIB_SEL4_TEST
    help
        Print XML output. Stdout will be buffered.

config HAVE_LIB_SEL4_TEST
    bool
```

## libsel4utils/Kconfig
```kconfig
#
# Copyright 2017, Data61
# Commonwealth Scientific and Industrial Research Organisation (CSIRO)
# ABN 41 687 119 230.
#
# This software may be distributed and modified according to the terms of
# the BSD 2-Clause license. Note that NO WARRANTY is provided.
# See "LICENSE_BSD2.txt" for details.
#
# @TAG(DATA61_BSD)
#

menuconfig LIB_SEL4_UTILS
    bool "libsel4utils"
    depends on HAVE_LIB_SEL4 && HAVE_LIBC && HAVE_LIB_ELF && HAVE_LIB_CPIO && HAVE_LIB_UTILS
    select HAVE_SEL4_LIBS
    select HAVE_LIB_SEL4_UTILS
    default y
    help
        A library of utils for building an OS on seL4, including virtual memory, process and
        thread creation.

if LIB_SEL4_UTILS
    config SEL4UTILS_STACK_SIZE
    int "Size of stacks in bytes to allocate if using vspace interface in this library"
    default 65536

    config SEL4UTILS_CSPACE_SIZE_BITS
    int "Size of default cspace to spawn processes with"
    range 4 27
    default 12

    config SEL4UTILS_PROFILE
    bool "Profiling tools"
    default n
    help
        Enables the functionality of a set of profiling tools. When disabled these profiling tools
        will compile down to nothing.
endif

config HAVE_LIB_SEL4_UTILS
    bool
```
